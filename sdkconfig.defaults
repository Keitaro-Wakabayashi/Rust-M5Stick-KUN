## sdkconfig.defaults
```kconfig
# ESP32 Configuration for M5StickC Plus2

# Rust std support
CONFIG_ESP32_PTHREAD_TASK_STACK_SIZE_DEFAULT=8192

# BT/BLE Configuration
CONFIG_BT_ENABLED=y
CONFIG_BTDM_CTRL_MODE_BLE_ONLY=y
CONFIG_BTDM_CTRL_MODE_BR_EDR_ONLY=n
CONFIG_BTDM_CTRL_MODE_BTDM=n
CONFIG_BT_BLUEDROID_ENABLED=y
CONFIG_BT_BLE_ENABLED=y

# Serial flasher config
CONFIG_ESPTOOLPY_FLASHSIZE_4MB=y
CONFIG_ESPTOOLPY_FLASHSIZE="4MB"

# Partition Table
CONFIG_PARTITION_TABLE_SINGLE_APP=y

# Compiler options
CONFIG_COMPILER_OPTIMIZATION_SIZE=y
CONFIG_COMPILER_OPTIMIZATION_ASSERTIONS_ENABLE=y

# ESP32-specific
CONFIG_ESP32_DEFAULT_CPU_FREQ_240=y
CONFIG_ESP32_DEFAULT_CPU_FREQ_MHZ=240

# FreeRTOS
CONFIG_FREERTOS_HZ=1000
CONFIG_FREERTOS_UNICORE=n

# Log output
CONFIG_LOG_DEFAULT_LEVEL_INFO=y
CONFIG_LOG_MAXIMUM_LEVEL_VERBOSE=y

# Main task stack size
CONFIG_ESP_MAIN_TASK_STACK_SIZE=8192

# Wi-Fi (disabled by default, enable if needed)
CONFIG_ESP_WIFI_ENABLED=n

# I2C Configuration (for IMU, AXP192)
CONFIG_I2C_ENABLE_HARDWARE_I2C_MASTER=y

# SPI Configuration (for LCD)
CONFIG_SPI_MASTER_ISR_IN_IRAM=y
```
